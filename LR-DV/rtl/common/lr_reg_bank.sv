// -----------------------------------------------------------------------------
// LR-DV common — APB-mapped register bank with shadow + interrupt aggregation
// -----------------------------------------------------------------------------
// 32-bit word-addressed; reads return current shadow; writes update shadow
// with per-register write-strobe pulses to downstream hardware.  W1C interrupt
// status + interrupt-enable mask registers at the top of the address space.
// Generated by `lr_csr_gen.py` from the YAML descriptor in docs/CSR.yaml.
// -----------------------------------------------------------------------------
`default_nettype none

module lr_reg_bank #(
    parameter int unsigned NUM_REGS  = 64,
    parameter int unsigned ADDR_BITS = 8
) (
    input  wire                       clk,
    input  wire                       rst_n,
    // APB slave
    input  wire  [ADDR_BITS-1:0]      paddr,
    input  wire                       psel,
    input  wire                       penable,
    input  wire                       pwrite,
    input  wire  [31:0]               pwdata,
    output logic [31:0]               prdata,
    output logic                      pready,
    output logic                      pslverr,
    // shadow + write strobes to design
    output logic [NUM_REGS-1:0][31:0] shadow,
    output logic [NUM_REGS-1:0]       wr_stb,
    // interrupt aggregation
    input  wire  [31:0]               irq_set,
    output logic                      irq
);

    logic [NUM_REGS-1:0][31:0] regs;
    logic [31:0]               irq_status, irq_enable;
    logic [ADDR_BITS-1:2]      word_addr;
    assign word_addr = paddr[ADDR_BITS-1:2];

    always_ff @(posedge clk or negedge rst_n) begin
        if (!rst_n) begin
            regs       <= '{default:'0};
            irq_status <= '0;
            irq_enable <= '0;
            wr_stb     <= '0;
        end else begin
            wr_stb <= '0;
            // sticky-W1C interrupt set
            irq_status <= (irq_status & ~( (psel && penable && pwrite &&
                          word_addr == NUM_REGS-2) ? pwdata : '0 )) | irq_set;
            if (psel && penable && pwrite) begin
                if (word_addr < NUM_REGS-2) begin
                    regs[word_addr]   <= pwdata;
                    wr_stb[word_addr] <= 1'b1;
                end
                if (word_addr == NUM_REGS-1) irq_enable <= pwdata;
            end
        end
    end

    always_comb begin
        prdata  = '0;
        pready  = 1'b1;
        pslverr = 1'b0;
        if (psel && !pwrite) begin
            if      (word_addr < NUM_REGS-2)    prdata = regs[word_addr];
            else if (word_addr == NUM_REGS-2)   prdata = irq_status;
            else                                prdata = irq_enable;
        end
    end

    assign shadow = regs;
    assign irq    = |(irq_status & irq_enable);

endmodule

`default_nettype wire
